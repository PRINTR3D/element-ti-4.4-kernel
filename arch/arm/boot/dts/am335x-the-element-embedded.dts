/*
 * Copyright (C) 2012 Texas Instruments Incorporated - http://www.ti.com/
 *
 * This program is free software; you can redistribute it and/or modify
 * it under the terms of the GNU General Public License version 2 as
 * published by the Free Software Foundation.
 *
 * Version is based on board ID. For the first production board it is 0.
 */
/dts-v1/;

#include "am33xx.dtsi"
#include "am335x-the-element-common.dtsi"

/ {
	model = "Printr AM335x The Element Embedded";
	compatible = "ti,am335x-the-element", "ti,am33xx";
};
